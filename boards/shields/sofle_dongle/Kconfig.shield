## boards/shields/sofle_dongle/Kconfig.shield
```kconfig
# No whitespace after the comma or in the keyboard name!
config SHIELD_SOFLE_DONGLE
    def_bool $(shields_list_contains,sofle_dongle)

config SHIELD_SOFLE_LEFT_PERIPHERAL
    def_bool $(shields_list_contains,sofle_left_peripheral)

config SHIELD_SOFLE_RIGHT_PERIPHERAL
    def_bool $(shields_list_contains,sofle_right_peripheral)
```
